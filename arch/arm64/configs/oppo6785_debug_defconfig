## arch/arm64/configs/oppo6785_debug_defconfig
```kconfig
CONFIG_CROSS_COMPILE="aarch64-linux-android-"
# CONFIG_LOCALVERSION_AUTO is not set
# CONFIG_FHANDLE is not set
CONFIG_IKHEADERS=m
CONFIG_LOG_BUF_SHIFT=19
CONFIG_UCLAMP_TASK=y
CONFIG_UCLAMP_GROUPS_COUNT=32
CONFIG_UCLAMP_MAP_OPP=y
CONFIG_UCLAMP_TASK_GROUP=y
CONFIG_CPUSETS=y
CONFIG_SCHED_TUNE=y
CONFIG_DEFAULT_USE_ENERGY_AWARE=y
# CONFIG_RD_BZIP2 is not set
# CONFIG_RD_LZMA is not set
# CONFIG_RD_XZ is not set
# CONFIG_RD_LZO is not set
# CONFIG_RD_LZ4 is not set
CONFIG_SYSCTL_SYSCALL=y
# CONFIG_KALLSYMS_BASE_RELATIVE is not set
CONFIG_CC_STACKPROTECTOR_STRONG=y
CONFIG_MODULE_SRCVERSION_ALL=y
# CONFIG_BLK_DEV_BSG is not set
CONFIG_MACH_MT6785=y
CONFIG_SCHED_MC=y
CONFIG_NR_CPUS=8
CONFIG_PREEMPT=y
# CONFIG_BOUNCE is not set
CONFIG_ZSMALLOC=y
CONFIG_RANDOMIZE_BASE=y
CONFIG_CMDLINE="console=tty0 console=ttyMT3,921600n1 root=/dev/ram vmalloc=496M slub_max_order=0 slub_debug=O "
# CONFIG_EFI is not set
CONFIG_BUILD_ARM64_APPENDED_DTB_IMAGE=y
CONFIG_BUILD_ARM64_DTB_OVERLAY_IMAGE=y
CONFIG_BUILD_ARM64_APPENDED_DTB_IMAGE_NAMES="mediatek/mt6785"
CONFIG_BUILD_ARM64_DTB_OVERLAY_IMAGE_NAMES="mediatek/oppo6785_20682 mediatek/oppo6785_20684 mediatek/oppo6785_19661"
# CONFIG_CORE_DUMP_DEFAULT_ELF_HEADERS is not set
CONFIG_COMPAT=y
CONFIG_PM_DEBUG=y
CONFIG_WQ_POWER_EFFICIENT_DEFAULT=y
CONFIG_CPU_FREQ=y
CONFIG_CPU_FREQ_STAT=y
CONFIG_CPU_FREQ_DEFAULT_GOV_SCHEDUTIL=y
CONFIG_CPU_FREQ_GOV_POWERSAVE=y
CONFIG_CPU_FREQ_GOV_USERSPACE=y
CONFIG_CPU_FREQ_GOV_ONDEMAND=y
CONFIG_XFRM_MIGRATE=y
CONFIG_SYN_COOKIES=y
CONFIG_BRIDGE=y
CONFIG_VLAN_8021Q=y
CONFIG_CLS_U32_PERF=y
CONFIG_CLS_U32_MARK=y
CONFIG_CFG80211=y
CONFIG_NL80211_TESTMODE=y
CONFIG_CFG80211_DEVELOPER_WARNINGS=y
# CONFIG_CFG80211_DEFAULT_PS is not set
CONFIG_CFG80211_DEBUGFS=y
CONFIG_CFG80211_INTERNAL_REGDB=y
CONFIG_MTK_NET_LOGGING=y
CONFIG_ZRAM=y
CONFIG_BLK_DEV_LOOP_MIN_COUNT=16
CONFIG_MEDIATEK_SOLUTION=y
CONFIG_MTK_PLATFORM="mt6785"
CONFIG_ARCH_MTK_PROJECT="oppo6785"
#CONFIG_MTK_AB_OTA_UPDATER=no
CONFIG_MTK_ENG_BUILD=y
CONFIG_MTK_GPT_SCHEME_SUPPORT=y
CONFIG_MTK_PMIC_NEW_ARCH=y
CONFIG_MTK_PMIC_COMMON=y
CONFIG_MTK_PMIC_CHIP_MT6359=y
CONFIG_MTK_EXTERNAL_CHARGER_TYPE_DETECT=y
CONFIG_MFD_MT6360_PMU=y
CONFIG_MT6360_PMU_CHARGER=y
CONFIG_MT6360_PMU_FLED=y
CONFIG_MT6360_PMIC=y
CONFIG_MT6360_LDO=y
CONFIG_MTK_PMIC_WRAP_HAL=y
CONFIG_MTK_APUSYS_MDLA_SUPPORT=y
CONFIG_MTK_CPU_FREQ=y
CONFIG_MTK_PTPOD=y
CONFIG_MTK_STATIC_POWER=y
CONFIG_MTK_UNIFY_POWER=y
CONFIG_MTK_CM_MGR=y
CONFIG_MTK_SWPM=y
CONFIG_MTK_THERMAL_PA_VIA_ATCMD=y
/*GaoWang@Cam.Drv add for 20682 camera BringUp 20200918*/
CONFIG_CAMERA_LDO=y
CONFIG_CUSTOM_KERNEL_IMGSENSOR="imx682_mipi_raw s5kgm1sp_mipi_raw sarter_qtech_main_s5kgm1sp imx471_mipi_raw1 ov8856_mipi_raw ov02b10_mipi_raw ov02b1b_mipi_mono s5kgw1_mipi_raw s5k3p9sp_mipi_raw gc2375h_mipi_raw_19661 gc02m0_mipi_mono gc02k0_mipi_raw salaa_qtech_main_s5kgm1sp sala_wide_ov8856"
CONFIG_CUSTOM_KERNEL_CAM_CAL_DRV="BRCB032GWZ_3 GT24c32a cat24c16"
CONFIG_MTK_CAMERA_ISP_RSC_SUPPORT=y
CONFIG_MTK_CAMERA_ISP_DPE_SUPPORT=y
CONFIG_MTK_CAMERA_ISP_TSF_SUPPORT=y
CONFIG_MTK_CAMERA_ISP_FD_SUPPORT=y
CONFIG_MTK_CAMERA_ISP_WPE_SUPPORT=y
CONFIG_MTK_CAMERA_ISP_OWE_SUPPORT=y
CONFIG_MTK_CAMERA_ISP_MFB_SUPPORT=y
CONFIG_MTK_CAM_CAL=y
CONFIG_MTK_CMDQ_V3=y
CONFIG_MTK_CMDQ=y
CONFIG_MTK_IMGSENSOR=y
CONFIG_MTK_JPEG=y
CONFIG_MTK_SMI_EXT=y
CONFIG_MTK_LCM=y
#ifndef ODM_HQ_EDIT
#liyan@ODM.Multimedia.LCD  2019/08/27 add for LCD bring up
#CONFIG_CUSTOM_KERNEL_LCM="otm1911a_fhdp_dsi_vdo_truly_rt4801 hx83112b_fhdp_dsi_vdo_auo_rt4801"
#else #ODM_HQ_EDIT
CONFIG_CUSTOM_KERNEL_LCM="nt36672c_fhdp_dsi_vdo_tianma_zal1878 nt36672c_fhdp_dsi_vdo_jdi_zal1878 nt36672c_fhdp_dsi_vdo_tianma_zal1852 nt36672c_fhdp_dsi_vdo_jdi_zal1852 nt36672c_fhdp_dsi_vdo_boe_zal1852"
#endif #ODM_HQ_EDIT
CONFIG_MTK_FB=y
CONFIG_MTK_LCM_PHYSICAL_ROTATION="0"
#ifndef ODM_HQ_EDIT
#longyajun@ODM.Multimedia.LCD  2020/01/14 add for round corner remove
#CONFIG_MTK_ROUND_CORNER_SUPPORT is not set
#endif #ODM_HQ_EDIT
#ifndef OPLUS_FEATURE_LCD
#liyan@ODM.Multimedia.LCD  2019/08/27 add for LCD bring up
#CONFIG_LCM_HEIGHT="2160"
#else #OPLUS_FEATURE_LCD
CONFIG_LCM_HEIGHT="2400"
#endif #OPLUS_FEATURE_LCD
CONFIG_MTK_AAL_SUPPORT=y
CONFIG_MTK_DYNAMIC_FPS_FRAMEWORK_SUPPORT=y
CONFIG_MTK_CCU=y
CONFIG_MTK_SENSOR_SUPPORT=y
CONFIG_MTK_SENSOR_ARCHITECTURE="1.0"
CONFIG_CUSTOM_KERNEL_ACCELEROMETER=y
CONFIG_MTK_ACCELHUB=y
CONFIG_CUSTOM_KERNEL_ALSPS=y
CONFIG_MTK_ALSPSHUB=y
CONFIG_CUSTOM_KERNEL_GYROSCOPE=y
CONFIG_MTK_GYROHUB=y
CONFIG_CUSTOM_KERNEL_MAGNETOMETER=y
CONFIG_MTK_MAGHUB=y
CONFIG_MTK_HWMON=y
#ifdef VENDOR_EDIT
#Yan.Chen@BSP.sensor,2018/11/08,remove nouser sensortype
#CONFIG_CUSTOM_KERNEL_BAROMETER=y
#CONFIG_MTK_BAROHUB=y
#endif

CONFIG_CUSTOM_KERNEL_SENSOR_FUSION=y
#ifdef VENDOR_EDIT
#Yan.Chen@BSP.sensor,2018/11/08,remove no-user sensortype
#CONFIG_CUSTOM_KERNEL_GRV_SENSOR=y
#CONFIG_CUSTOM_KERNEL_GMRV_SENSOR=y
#CONFIG_CUSTOM_KERNEL_RV_SENSOR=y
#CONFIG_CUSTOM_KERNEL_LINEARACCEL_SENSOR=y
#CONFIG_CUSTOM_KERNEL_GRAVITY_SENSOR=y
#endif
CONFIG_CUSTOM_KERNEL_UNCALI_ACC_SENSOR=y
CONFIG_CUSTOM_KERNEL_UNCALI_GYRO_SENSOR=y
CONFIG_CUSTOM_KERNEL_UNCALI_MAG_SENSOR=y
CONFIG_MTK_UNCALI_MAGHUB=y
CONFIG_MTK_UNCALI_GYROHUB=y
CONFIG_MTK_UNCALI_ACCHUB=y
CONFIG_CUSTOM_KERNEL_STEP_COUNTER=y
CONFIG_MTK_STEPSIGNHUB=y
CONFIG_CUSTOM_KERNEL_SITUATION=y
CONFIG_MTK_STATHUB=y
CONFIG_MTK_WAKEHUB=y
CONFIG_MTK_GLGHUB=y
CONFIG_MTK_PICKUPHUB=y
CONFIG_MTK_DEVICE_ORIENTATION_HUB=y
CONFIG_MTK_MOTION_DETECT_HUB=y
CONFIG_MTK_TILTDETECTHUB=y
CONFIG_CUSTOM_KERNEL_SENSORHUB=y
CONFIG_MTK_COMBO=y
CONFIG_MTK_COMBO_CHIP_CONSYS_6785=y
CONFIG_MTK_COMBO_GPS=y
CONFIG_MTK_COMBO_WIFI=y
CONFIG_MTK_DHCPV6C_WIFI=y
CONFIG_MTK_GPS_SUPPORT=y
CONFIG_MTK_FMRADIO=y
CONFIG_MTK_FM_CHIP="MT6631_FM"
CONFIG_MTK_CONNSYS_DEDICATED_LOG_PATH=y
#ifdef ODM_HQ_EDIT
#shiguibiao@ODM_HQ.Network.Modem.no id, 2019/10/30,set Modem FDD4M
CONFIG_MTK_MD1_SUPPORT=9
#endif /*ODM_HQ_EDIT*/
CONFIG_MTK_ECCCI_DRIVER=y
CONFIG_MTK_ECCCI_C2K=y
CONFIG_MTK_BTIF=y
CONFIG_MTK_ACCDET=y
CONFIG_ACCDET_EINT_IRQ=y
CONFIG_ACCDET_SUPPORT_EINT0=y
#ifdef HQ_ODM_EDIT
#liuyong@RM.CM.BSP.Charger 2020/07/27 add for charger adc
#CONFIG_MTK_AUXADC=y
#endif /*HQ_ODM_EDIT*/
CONFIG_MTK_LENS=y
CONFIG_MTK_LENS_FP5516AF_SUPPORT=y
CONFIG_MTK_FLASHLIGHT=y
CONFIG_MTK_FLASHLIGHT_MT6360=y
CONFIG_MTK_FLASHLIGHT_PT=y
CONFIG_MTK_FLASHLIGHT_PT_STRICT=y
CONFIG_MTK_FLASHLIGHT_DLPT=y
CONFIG_MTK_TINYSYS_SCP_SUPPORT=y
CONFIG_MTK_LEDS=y
CONFIG_MTK_IRTX_PWM_SUPPORT=y
CONFIG_MTK_PWM=y
CONFIG_MTK_CHIP=y
CONFIG_MTK_IDLE_BALANCE_ENHANCEMENT=y
CONFIG_MTK_SCHED_EAS_POWER_SUPPORT=y
CONFIG_SCHED_HMP=y
CONFIG_MTK_SCHED_BOOST=y
CONFIG_MTK_SCHED_RQAVG_KS=y
CONFIG_MTK_SCHED_RQAVG_US=y
CONFIG_MTK_SCHED_CPULOAD=y
CONFIG_MTK_RT_THROTTLE_MON=y
CONFIG_MTK_RAM_CONSOLE=y
CONFIG_MTK_AEE_FEATURE=y
CONFIG_MTK_RTC=y
CONFIG_MTK_USB_TYPEC_U3_MUX=y
CONFIG_TCPC_MT6360=y
CONFIG_MTK_TYPEC_WATER_DETECT=y
#ifdef ODM_HQ_EDIT
#Liu.Yong@RM.CM.Charger 2020/07/27 modified for water detect
# CONFIG_MTK_TYPEC_WATER_DETECT_BY_PCB is not set
#endif
CONFIG_TCPC_CLASS=y
CONFIG_USB_POWER_DELIVERY=y
CONFIG_MTK_LOAD_TRACKER=y
CONFIG_MTK_CPU_CTRL_CFP=y
CONFIG_MTK_PERF_OBSERVER=y
CONFIG_MTK_RESYM=y
CONFIG_MTK_FPSGO_V3=y
CONFIG_MTK_EARA_THERMAL=y
CONFIG_MTK_PERF_TRACKER=y
CONFIG_MTK_LOWMEM_HINT=y
CONFIG_MTPROF=y
CONFIG_MTK_SCHED_MONITOR=y
CONFIG_MTK_WQ_DEBUG=y
CONFIG_MTK_IRQ_COUNT_TRACER=y
CONFIG_MTK_IRQ_OFF_TRACER=y
CONFIG_MTK_PREEMPT_TRACER=y
CONFIG_ANDROID_DEFAULT_SETTING=y
CONFIG_MTK_ANDROID_DEFAULT_SETTING=y
CONFIG_MTK_TIMER_TIMESYNC=y
CONFIG_MTK_HIGH_FRAME_RATE=y
CONFIG_MTK_FREQ_HOPPING=y
CONFIG_MTK_TINYSYS_SSPM_SUPPORT=y
CONFIG_MTK_GPU_SUPPORT=y
CONFIG_MTK_GPU_VERSION="mali bifrost r25p0"
CONFIG_MTK_GPU_COMMON_DVFS_SUPPORT=y
CONFIG_MTK_VIBRATOR=y
CONFIG_MTK_SELINUX_AEE_WARNING=y
CONFIG_MTK_SYNC=y
CONFIG_MTK_VPU_SUPPORT=y
CONFIG_MTK_DRAM_LOG_STORE=y
CONFIG_MTK_DRAM_LOG_STORE_ADDR=0x0011DF00
CONFIG_MTK_DRAM_LOG_STORE_SIZE=0x100
CONFIG_SCSI=y
CONFIG_BLK_DEV_SD=y
CONFIG_SCSI_SCAN_ASYNC=y
CONFIG_SCSI_UFSHCD=y
CONFIG_SCSI_UFSHCD_PLATFORM=y
CONFIG_MTK_UFS_SUPPORT=y
CONFIG_BLK_DEV_DM=y
CONFIG_DM_DEBUG=y
CONFIG_DM_CRYPT=y
CONFIG_DM_UEVENT=y
CONFIG_DM_VERITY_FEC=y
CONFIG_DM_BOW=y
CONFIG_IFB=y
# CONFIG_ETHERNET is not set
CONFIG_PPP_FILTER=y
CONFIG_PPP_MULTILINK=y
CONFIG_PPPOE=y
CONFIG_PPP_ASYNC=y
CONFIG_PPP_SYNC_TTY=y
# CONFIG_KEYBOARD_ATKBD is not set
CONFIG_KEYBOARD_MTK=y
#/* Yonghai.Wang@BSP.bootloader.bootflow, 2020/9/17, add for key function. */
# CONFIG_ONEKEY_REBOOT_NORMAL_MODE=y
# CONFIG_ONEKEY_REBOOT_OTHER_MODE=y
CONFIG_TWOKEY_REBOOT_NORMAL_MODE=y
CONFIG_TWOKEY_REBOOT_OTHER_MODE=y
CONFIG_KPD_PWRKEY_USE_PMIC=y
# CONFIG_INPUT_MOUSE is not set
CONFIG_INPUT_TOUCHSCREEN=y
#CONFIG_TOUCHSCREEN_MTK_TOUCH="GT9886 GT1151"
#ifdef OPLUS_FEATURE_TP_BASIC
#/*Xiaofei.Gong@BSP.TP.Function, 2020/09/15, bringup add for sala touchscreen.*/
CONFIG_TOUCHPANEL_NOVA=y
CONFIG_TOUCHPANEL_NOVA_NT36672C_NOFLASH=y
CONFIG_TOUCHPANEL_ALGORITHM=y
CONFIG_TOUCHPANEL_MTK_PLATFORM=y
CONFIG_INPUT_MISC=y
CONFIG_INPUT_UINPUT=y
#/*Xiaofei.Gong@BSP.TP.Function, 2020/09/15, bringup add for sala touchscreen.*/
#endif OPLUS_FEATURE_TP_BASIC
# CONFIG_SERIO is not set
# CONFIG_VT is not set
CONFIG_LEGACY_PTY_COUNT=16
# CONFIG_DEVMEM is not set
CONFIG_SERIAL_8250=y
CONFIG_SERIAL_8250_CONSOLE=y
CONFIG_SERIAL_8250_NR_UARTS=2
CONFIG_SERIAL_8250_RUNTIME_UARTS=2
CONFIG_SERIAL_8250_MT6577=y
CONFIG_I2C_MTK=y
CONFIG_SPI=y
CONFIG_SPI_MT65XX=y
CONFIG_MTK_GAUGE_VERSION=30
CONFIG_MTK_CHARGER=y
CONFIG_MTK_KERNEL_POWER_OFF_CHARGING=y
CONFIG_OPLUS_SMART_CHARGER_SUPPORT=y
# CONFIG_HWMON is not set
CONFIG_THERMAL=y
CONFIG_THERMAL_DEFAULT_GOV_BACKWARD_COMPATIBLE=y
CONFIG_WATCHDOG=y
CONFIG_MTK_WATCHDOG_COMMON=y
CONFIG_MTK_WATCHDOG_COMMON_V2=y
CONFIG_MFD_MT6358=y
CONFIG_MT6358_MISC=y
CONFIG_REGULATOR=y
CONFIG_REGULATOR_MT6359=y
CONFIG_MEDIA_SUPPORT=y
CONFIG_MEDIA_CAMERA_SUPPORT=y
CONFIG_V4L_PLATFORM_DRIVERS=y
CONFIG_V4L_MEM2MEM_DRIVERS=y
CONFIG_VIDEO_MEDIATEK_VCU_WO_FUSE=y
CONFIG_VB2_MEDIATEK_DMA_CONTIG=y
CONFIG_VIDEO_MEDIATEK_VCODEC=y
CONFIG_FB_MODE_HELPERS=y
CONFIG_FB_TILEBLITTING=y
CONFIG_LOGO=y
CONFIG_SND_HRTIMER=y
CONFIG_SND_DYNAMIC_MINORS=y
CONFIG_SND_VERBOSE_PRINTK=y
CONFIG_SND_DEBUG=y
CONFIG_SND_DEBUG_VERBOSE=y
CONFIG_SND_PCM_XRUN_DEBUG=y
CONFIG_SND_SEQUENCER=y
CONFIG_SND_SEQ_DUMMY=y
# CONFIG_SND_SPI is not set
CONFIG_SND_USB_AUDIO=y
CONFIG_SND_SOC=y
CONFIG_SND_SOC_MT6785_MT6359=y
CONFIG_SND_SOC_MTK_BTCVSD=y
# wuhui@ODM.CM.Multimedia.Audio 2020/09/08 modified for audio bringup
#CONFIG_SND_SOC_MT6660 is not set
CONFIG_HIDRAW=y
CONFIG_HID_A4TECH=y
CONFIG_HID_APPLE=y
CONFIG_HID_BELKIN=y
CONFIG_HID_CHERRY=y
CONFIG_HID_CHICONY=y
CONFIG_HID_CYPRESS=y
CONFIG_HID_DRAGONRISE=y
CONFIG_HID_EZKEY=y
CONFIG_HID_KYE=y
CONFIG_HID_GYRATION=y
CONFIG_HID_TWINHAN=y
CONFIG_HID_KENSINGTON=y
CONFIG_HID_LOGITECH=y
CONFIG_HID_MAGICMOUSE=y
CONFIG_HID_MICROSOFT=y
CONFIG_HID_MONTEREY=y
CONFIG_HID_PANTHERLORD=y
CONFIG_HID_PETALYNX=y
CONFIG_HID_SAMSUNG=y
CONFIG_HID_SUNPLUS=y
CONFIG_HID_GREENASIA=y
CONFIG_HID_SMARTJOYPLUS=y
CONFIG_HID_TOPSEED=y
CONFIG_HID_THRUSTMASTER=y
CONFIG_HID_ZEROPLUS=y
CONFIG_USB_XHCI_HCD=y
CONFIG_USB_STORAGE=y
CONFIG_USB_STORAGE_DATAFAB=y
CONFIG_USB_STORAGE_FREECOM=y
CONFIG_USB_STORAGE_ISD200=y
CONFIG_USB_STORAGE_USBAT=y
CONFIG_USB_STORAGE_SDDR09=y
CONFIG_USB_STORAGE_SDDR55=y
CONFIG_USB_STORAGE_JUMPSHOT=y
CONFIG_USB_STORAGE_ALAUDA=y
CONFIG_USB_STORAGE_ONETOUCH=y
CONFIG_USB_STORAGE_KARMA=y
CONFIG_USB_STORAGE_CYPRESS_ATACB=y
CONFIG_USB_MTU3=y
CONFIG_USB_MTU3_PLAT_PHONE=y
CONFIG_USB_TRANCEVIBRATOR=y
CONFIG_NOP_USB_XCEIV=y
CONFIG_DUAL_ROLE_USB_INTF=y
CONFIG_USB_GADGET_VBUS_DRAW=500
CONFIG_USB_CONFIGFS_SERIAL=y
CONFIG_USB_CONFIGFS_ACM=y
CONFIG_USB_CONFIGFS_RNDIS=y
CONFIG_USB_CONFIGFS_MASS_STORAGE=y
CONFIG_USB_CONFIGFS_F_HID=y
CONFIG_MMC=y
CONFIG_MMC_BLOCK_MINORS=32
CONFIG_MMC_MTK_PRO=y
CONFIG_MTK_EMMC_SUPPORT=y
CONFIG_MTK_EMMC_CACHE=y
CONFIG_MTK_EMMC_SUPPORT_OTP=y
CONFIG_MTK_EMMC_HW_CQ=y
CONFIG_NEW_LEDS=y
CONFIG_LEDS_CLASS=y
CONFIG_LEDS_TRIGGERS=y
CONFIG_LEDS_TRIGGER_TIMER=y
# CONFIG_RTC_SYSTOHC is not set
CONFIG_RTC_DRV_MT6358=y
CONFIG_DMADEVICES=y
CONFIG_DMA_MTK_UART=y
CONFIG_SW_SYNC=y
CONFIG_ANDROID_INTF_ALARM_DEV=y
CONFIG_ION=y
CONFIG_MTK_ION=y
CONFIG_NANOHUB=y
CONFIG_NANOHUB_MTK_IPI=y
CONFIG_MAILBOX=y
CONFIG_MTK_CMDQ_MBOX=y
CONFIG_MTK_PMIC_WRAP=y
CONFIG_EXTCON_MTK_USB=y
CONFIG_IIO=y
CONFIG_IIO_BUFFER=y
CONFIG_IIO_KFIFO_BUF=y
CONFIG_MEDIATEK_MT6577_AUXADC=y
CONFIG_MT635X_AUXADC=y
CONFIG_PHY_MTK_USB=y
CONFIG_QUOTA_NETLINK_INTERFACE=y
CONFIG_ISO9660_FS=y
CONFIG_JOLIET=y
CONFIG_ZISOFS=y
CONFIG_MSDOS_FS=y
CONFIG_VFAT_FS=y
CONFIG_TMPFS=y
CONFIG_PSTORE=y
CONFIG_PSTORE_CONSOLE=y
CONFIG_PSTORE_PMSG=y
CONFIG_PSTORE_RAM=y
# CONFIG_NETWORK_FILESYSTEMS is not set
CONFIG_NLS_CODEPAGE_437=y
CONFIG_NLS_CODEPAGE_950=y
CONFIG_NLS_ASCII=y
CONFIG_NLS_ISO8859_1=y
CONFIG_NLS_UTF8=y
CONFIG_PRINTK_TIME=y
CONFIG_DYNAMIC_DEBUG=y
CONFIG_DEBUG_INFO=y
CONFIG_FRAME_WARN=2800
CONFIG_PAGE_OWNER=y
CONFIG_DEBUG_SECTION_MISMATCH=y
CONFIG_DEBUG_PAGEALLOC=y
CONFIG_DEBUG_PAGEALLOC_ENABLE_DEFAULT=y
CONFIG_SLUB_DEBUG_ON=y
CONFIG_DEBUG_KMEMLEAK=y
CONFIG_DEBUG_KMEMLEAK_EARLY_LOG_SIZE=9600
CONFIG_DEBUG_KMEMLEAK_DEFAULT_OFF=y
CONFIG_DEBUG_VIRTUAL=y
CONFIG_PANIC_ON_OOPS=y
CONFIG_PANIC_TIMEOUT=5
CONFIG_SCHEDSTATS=y
CONFIG_SCHED_STACK_END_CHECK=y
#ifdef ODM_HQ_EDIT
##longyajun@ODM.Multimedia.LCD 2020/05/19 add for console_lock debug
CONFIG_LOCKDEP=y
CONFIG_DEBUG_PREEMPT=y
CONFIG_LOCK_STAT = y
CONFIG_DEBUG_MUTEXES=y
#endif
CONFIG_PROVE_LOCKING=y
CONFIG_DEBUG_LOCKDEP=y
CONFIG_DEBUG_ATOMIC_SLEEP=y
#ifdef ODM_HQ_EDIT
##longyajun@ODM.Multimedia.LCD 2020/05/19 add for console_lock debug
MTK_LOCK_MONITOR=y
#endif
CONFIG_RCU_CPU_STALL_TIMEOUT=60
CONFIG_RCU_TRACE=y
CONFIG_FAULT_INJECTION=y
CONFIG_MTK_SCHED_TRACERS=y
CONFIG_MTK_FTRACE_DEFAULT_ENABLE=y
CONFIG_DMA_API_DEBUG=y
CONFIG_BUG_ON_DATA_CORRUPTION=y
CONFIG_KGDB=y
CONFIG_KGDB_KDB=y
CONFIG_CRYPTO_TWOFISH=y
# CONFIG_CRYPTO_HW is not set
#ifdef VENDOR_EDIT
# Long.Liu@PSW.BSP.Fingerprint.Basic, 2018/9/25, Add for fingerprint driver
CONFIG_OPPO_FINGERPRINT=y
CONFIG_OPPO_FINGERPRINT_MTK=y
CONFIG_OPPO_FINGERPRINT_GOODIX=y
CONFIG_OPPO_FINGERPRINT_FPC=y

# wuhui@ODM.CM.Multimedia.Audio 2020/09/24 modified for dsp bringup
CONFIG_MTK_AUDIODSP_SUPPORT=y
CONFIG_SND_SOC_MTK_AUDIO_DSP=y
# wuhui@ODM.HQ.Multimedia.Audio 2020/09/08 added for aw87339 bringup
CONFIG_SND_SOC_AW87339=y
# wuhui@ODM.CM.Multimedia.Audio 2020/09/08 added for aw87359 bringup
CONFIG_SND_SOC_AW87359=y
#endif /*VENDOR_EDIT*/
CONFIG_CRC8=y
#ifdef VENDOR_EDIT
# wanghao@BSP.Kernel.Driver, 2020/03/26, add for common soft
CONFIG_OPPO_COMMON_SOFT=y
CONFIG_OPPO_DEVICE_IFNO=y
CONFIG_SECTION_MISMATCH_WARN_ONLY=y
#endif
#ifdef VENDOR_EDIT
#wen.luo@BSP.Kernel.Stability, 2020/03/26, all system oplus feature writer here
CONFIG_OPLUS_FEATURE_OPROJECT=y
#endif

#ifdef VENDOR_EDIT
##Ping.Liu@BSP.Fingerprint.Secure, 2020/05/18, add for open trustonic tee, config tee.
CONFIG_TEE=y
CONFIG_TRUSTONIC_TEE_SUPPORT=y
CONFIG_MTK_TEE_GP_SUPPORT=y
CONFIG_TRUSTONIC_TEE_VERSION=500
##endif /*VENDOR_EDIT*/
# ifdef ODM_HQ_EDIT
# Liu.Yong@RM.CM.Charger 2020/07/27 modified for bring up charging
CONFIG_OPLUS_HQ_CHARGER=y
CONFIG_OPLUS_CHARGER_MT6370_TYPEC=y
CONFIG_OPLUS_CHARGER=y
CONFIG_OPLUS_CHARGER_MTK=y
CONFIG_OPLUS_CHARGER_MTK_CHGIC=y
#CONFIG_OPLUS_CHARGER_MTK6785=y
CONFIG_OPLUS_CHARGER_MTK6889=y
CONFIG_OPLUS_4400MV_BATTERY_SUPPORT=y
CONFIG_OPLUS_CALL_MODE_SUPPORT=y
CONFIG_OPLUS_CHECK_CHARGERID_VOLT=y
CONFIG_OPLUS_SHIP_MODE_SUPPORT=y
CONFIG_OPLUS_SHORT_C_BATT_CHECK=y
CONFIG_OPLUS_SHORT_HW_CHECK=y
CONFIG_OPLUS_SHORT_USERSPACE=y
CONFIG_OPLUS_RTC_DET_SUPPORT=y
CONFIG_OPLUS_HVDCP_SUPPORT=y
CONFIG_OPLUS_SHORT_IC_CHECK=y
CONFIG_OPLUS_CHIP_SOC_NODE=y
#endif
#ifdef ODM_HQ_EDIT
# wangtao@ODM_HQ.BSP.Kernel.Boot,2019/10/24,Add for ODM_HQ_EDIT macro for kernel usage
CONFIG_ODM_HQ_EDIT=y
#endif
#jason.tang@TECH.BSP.Kernel.Storage, 2019-10-25, enable EXT4_FSYNC
CONFIG_EXT4_FSYNC=y
#ifdef VENDOR_EDIT//Fanhong.Kong@ProDrv.CHG,add 2016/6/20 for kernel 4.14 exfat
CONFIG_EXFAT_FS=y
#endif
#ifdef OPLUS_FEATURE_TP_BASIC Xuhang.Li@BSP.TP, 20200726, add touchpanel driver
CONFIG_OPPO_ARCH_FILE=y
CONFIG_OPPO_DEVICE_IFNO=y
CONFIG_OPPO_COMMON_SOFT=y
CONFIG_FW_LOADER_USER_HELPER=y
CONFIG_FW_LOADER_USER_HELPER_FALLBACK=y
CONFIG_TOUCHPANEL_MTK_PLATFORM=y
CONFIG_TOUCHPANEL_OPPO=y
CONFIG_TOUCHPANEL_LATE_INIT=y
CONFIG_TOUCHPANEL_SAMSUNG=y
CONFIG_TOUCHPANEL_SAMSUNG_S6SY791=y
CONFIG_TOUCHPANEL_SYNAPTICS=y
CONFIG_TOUCHPANEL_SYNAPTICS_TCM_ONCELL=y
#endif OPLUS_FEATURE_TP_BASIC
CONFIG_MTK_ENABLE_GENIEZONE=y

#ifdef OPLUS_FEATURE_PROCESS_RECLAIM
#Kui.Zhang@BSP.Kernel.MM, 2020-05-20 add process memry reclaim
CONFIG_PROCESS_RECLAIM=y
#endif

#ifdef OPLUS_FEATURE_SENSOR_ALGORITHM
#/*xiebaixue@PSW.BSP.Sensor, 2020/04/16, Add for sensor algo*/
CONFIG_OPLUS_FEATURE_CAMERA_PROTECT=y
CONFIG_OPLUS_FEATURE_FREE_FALL=y
CONFIG_OPLUS_FEATURE_PICKUP_DETECT=y
CONFIG_OPLUS_FEATURE_FP_DISPLAY=y
CONFIG_OPLUS_FEATURE_LUX_AOD=y
CONFIG_OPLUS_FEATURE_PEDO_MINUTE=y
CONFIG_OPLUS_FEATURE_TP_GESTURE=y
#endif /*OPLUS_FEATURE_SENSOR_ALGORITHM*/

#ifdef OPLUS_FEATURE_ACTIVITY_RECOGNITION
#pengqingqing@ANDROID.AITECH,2020/07/01, add for oppo_activity_recognition
CONFIG_OPLUS_FEATURE_ACTIVITY_RECOGNITION=y
#endif //OPLUS_FEATURE_ACTIVITY_RECOGNITION

#ifdef OPLUS_FEATURE_ELEVATOR_DETECT
#pengqingqing@ANDROID.AITECH,2020/07/29, add for elevator_detect
CONFIG_OPLUS_FEATURE_ELEVATOR_DETECT=y
#endif //OPLUS_FEATURE_ELEVATOR_DETECT

#ifdef OPLUS_FEATURE_HANS_FREEZE
#Kun.Zhou@ANDROID.RESCONTROL, 2019/09/23, add for hans freeze manager
CONFIG_OPPO_HANS=y
#endif /*OPLUS_FEATURE_HANS_FREEZE*/
#ifdef VENDOR_EDIT
#LinJunBin@CONNECTIVITY.NFC.BASIC , 2020/09/19, add for : add NXP NFC driver
CONFIG_NFC_PN553_DEVICES=y
#endif

#ifdef VENDOR_EDIT
#/*Chendai.Liang@BSP.Sensor.Basic, add oppo als cali value*/
CONFIG_OPPO_ALS_CALI=y
#endif

#ifdef OPLUS_FEATURE_SECURITY_COMMON
#Shupeng.Zhou@BSP.Security.Basic, 2020/09/08, Enable SecureBoot Fuse
CONFIG_MTK_SECURITY_SW_SUPPORT=y
#endif /*OPLUS_FEATURE_SECURITY_COMMON*/

#ifdef OPLUS_FEATURE_SECURITY_COMMON
#Shupeng.Zhou@BSP.Security.Basic, 2020/09/30, Add for mtk encryption feature  */
CONFIG_FS_ENCRYPTION_INLINE_CRYPT=y
CONFIG_BLK_INLINE_ENCRYPTION=y
CONFIG_BLK_INLINE_ENCRYPTION_FALLBACK=y
CONFIG_SCSI_UFS_CRYPTO=y
CONFIG_F2FS_FS_ENCRYPTION=y
CONFIG_MMC_CRYPTO_LEGACY=y
#endif  /* OPLUS_FEATURE_SECURITY_COMMON */

#ifdef OPLUS_FEATURE_PHOENIX
#Fuchun.Liao@BSP.Kernel.Stability add for enable phoenix
CONFIG_OPLUS_FEATURE_PHOENIX=y
#endif

#Move all oplus feature to here,TODO ...
#ifdef VENDOR_EDIT
#wen.luo@BSP.Kernel.Stability, 2020/03/26, all system oplus feature writer here
CONFIG_DETECT_HUNG_TASK=y
CONFIG_OPLUS_FEATURE_HUNG_TASK_ENHANCE=y
CONFIG_DEFAULT_HUNG_TASK_TIMEOUT=60
#endif

#ifdef OPLUS_FEATURE_UIFIRST
#// XuHaifeng@BSP.KERNEL.PERFORMANCE, 2020/08/18, Add for UIFirst(slide boost)
CONFIG_SCHED_WALT=y
#endif

#ifdef OPLUS_FEATURE_HEALTHINFO
#/* Liujie.Xie@TECH.Kernel.Sched, 2020-05-20, add jank info monitor support*/
CONFIG_OPPO_JANK_INFO=y
#endif /* OPLUS_FEATURE_HEALTHINFO */
#ifdef OPLUS_FEATURE_HEALTHINFO
#/* Huacai.Zhou@PSW.BSP.Kernel.MM, 2018-07-07, add alloc wait monitor support*/
CONFIG_OPPO_MEM_MONITOR=y
CONFIG_FG_TASK_UID=y
CONFIG_OPPO_HEALTHINFO=y
CONFIG_SCHEDSTATS=y
#endif /*OPLUS_FEATURE_HEALTHINFO*/

#ifdef VENDOR_EDIT
#Qiwu.Chen@BSP.Kernel.Stability, 2020/10/9, enable shutdown detect
CONFIG_OPLUS_FEATURE_SHUTDOWN_DETECT=y
#endif

#ifdef OPLUS_FEATURE_FEEDBACK
#zhouhengguo@BSP.Kernel.Stability, 2020/09/27, add feedback feature
CONFIG_OPLUS_FEATURE_FEEDBACK=y
#endif /*OPLUS_FEATURE_FEEDBACK*/

#ifdef OPLUS_FEATURE_FG_IO_OPT
#wangtao@BSP.Kernel.mm 2020/08/24, increase priority of foreground IO
CONFIG_OPPO_FG_IO_OPT=y
#endif

#ifdef VENDOR_EDIT
#/* LiYue@BSP.CHG.Basic, 2019/09/11, add for Joystick */
CONFIG_INPUT_JOYSTICK=y
CONFIG_JOYSTICK_XPAD=y
CONFIG_JOYSTICK_XPAD_FF=y
CONFIG_JOYSTICK_XPAD_LEDS=y
#endif
CONFIG_SECURITY_SELINUX_DEVELOP=y

#ifdef OPLUS_FEATURE_ACM
#Yuwei.Guan@BSP.Kernel.FS,2020/07/08, Add for acm
CONFIG_OPLUS_FEATURE_ACM=y
CONFIG_OPLUS_FEATURE_ACM_LOGGING=y
#endif /* OPLUS_FEATURE_ACM */

#ifdef OPLUS_FEATURE_SECURITY_COMMON
#Shupeng.Zhou@BSP.Security.Basic, 2020/09/30, Add for enable avb 2.0
CONFIG_MTK_AVB20_SUPPORT = y
#endif  /* OPLUS_FEATURE_SECURITY_COMMON */

#ifdef OPLUS_FEATURE_SECURITY_COMMON
#Shupeng.Zhou@BSP.Security.Basic, 2020/11/20, add for widevine L1
CONFIG_MTK_SEC_VIDEO_PATH_SUPPORT=y
CONFIG_MTK_DRM_KEY_MNG_SUPPORT=y
#endif /* OPLUS_FEATURE_SECURITY_COMMON */

#ifdef OPLUS_FEATURE_SDCARD
#Zhenxi.Wei@BSP.Storage.Sdcard add for sdcard support
CONFIG_OPLUS_FEATURE_SDCARD=y
#endif

#//yh@PSW.BSP.Storage.EXT4, 2018-11-26 add for ext4 async discard suppot
CONFIG_EXT4_ASYNC_DISCARD_SUPPORT=y
#endif

#ifdef VENDOR_EDIT
#/* huangjianan@TECH.Storage.FS, 2020/06/03, Add for fs feature */
CONFIG_OPLUS_FEATURE_EXT4_FSYNC=y
#endif

#ifdef OPLUS_FEATURE_ZRAM_OPT
CONFIG_OPLUS_ZRAM_OPT=y
CONFIG_CRYPTO_LZ4=y
CONFIG_PGTABLE_MAPPING=y
#endif /* OPLUS_FEATURE_ZRAM_OPT */

#ifdef OPLUS_ARCH_EXTENDS
#xijing.Zhou@MM.AUDIODRIVER.FEATURE, 2020/10/16, modify for VOW
CONFIG_MTK_VOW_SUPPORT=y
CONFIG_MTK_VOW_BARGE_IN_SUPPORT=y
CONFIG_MTK_VOW_AMAZON_SUPPORT=y
CONFIG_MTK_VOW_GVA_SUPPORT=y
#endif /* OPLUS_ARCH_EXTENDS */

#ifdef OPLUS_FEATURE_SIM
#Yuchun.Luo@NETWORK.SIM, 2020/12/16, modify for sim detect
CONFIG_SIM_DETECT=y
#endif

#ifdef OPLUS_FEATURE_SECURITY_COMMON
#Qingyu.Li@BSP.Security.Basic, ModuleSig, Fix the MTK issue, resulting in the signed .ko not being correctly placed in the vendor.img. 2021-03-04
#CONFIG_MODULE_SIG=y
#CONFIG_MODULE_SIG_FORCE=y
#CONFIG_MODULE_SIG_ALL=y
#CONFIG_MODULE_SIG_SHA512=y
#endif /* OPLUS_FEATURE_SECURITY_COMMON */
```
