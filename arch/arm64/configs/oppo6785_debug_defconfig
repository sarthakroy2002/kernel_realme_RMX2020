## drivers/misc/mediatek/sensor/2.0/Kconfig
```kconfig
source "drivers/misc/mediatek/sensor/2.0/lsm6dsm_secondary/Kconfig"
source "drivers/misc/mediatek/sensor/2.0/test/Kconfig"
source "drivers/misc/mediatek/sensor/2.0/oppo_virtual_sensor/Kconfig"
source "drivers/misc/mediatek/sensor/2.0/oppo_virtual_sensor/Kconfig"
source "drivers/misc/mediatek/sensor/2.0/oppo_virtual_sensor/camera_protecthub/Kconfig"
source "drivers/misc/mediatek/sensor/2.0/oppo_virtual_sensor/free_fallhub/Kconfig"
source "drivers/misc/mediatek/sensor/2.0/oppo_virtual_sensor/pickup_detecthub/Kconfig"
source "drivers/misc/mediatek/sensor/2.0/oppo_virtual_sensor/fp_displayhub/Kconfig"
source "drivers/misc/mediatek/sensor/2.0/oppo_virtual_sensor/lux_aodhub/Kconfig"
source "drivers/misc/mediatek/sensor/2.0/oppo_virtual_sensor/pedo_minutehub/Kconfig"
source "drivers/misc/mediatek/sensor/2.0/oppo_virtual_sensor/oppo_activity_recognitionhub/Kconfig"
source "drivers/misc/mediatek/sensor/2.0/oppo_virtual_sensor/elevator_detecthub/Kconfig"
```

## drivers/misc/mediatek/sensor/2.0/oppo_sensor_devinfo/Kconfig
```kconfig
config OPPO_SENSOR_MTK6885
	bool "for MediaTek 6885"
	default n
	help
	  It support 6885.
```

## drivers/misc/mediatek/sensors-1.0/Kconfig
```kconfig
source "drivers/misc/mediatek/sensors-1.0/accelerometer/Kconfig"
source "drivers/misc/mediatek/sensors-1.0/alsps/Kconfig"
source "drivers/misc/mediatek/sensors-1.0/gyroscope/Kconfig"
source "drivers/misc/mediatek/sensors-1.0/magnetometer/Kconfig"
source "drivers/misc/mediatek/sensors-1.0/hwmon/Kconfig"
source "drivers/misc/mediatek/sensors-1.0/barometer/Kconfig"
#source "drivers/misc/mediatek/sensors-1.0/accelgyro/Kconfig"
#source "drivers/misc/mediatek/sensors-1.0/humidity/Kconfig"
source "drivers/misc/mediatek/sensors-1.0/activity_sensor/Kconfig"
#source "drivers/misc/mediatek/sensors-1.0/pedometer/Kconfig"
source "drivers/misc/mediatek/sensors-1.0/sensorfusion/Kconfig"
source "drivers/misc/mediatek/sensors-1.0/step_counter/Kconfig"
source "drivers/misc/mediatek/sensors-1.0/situation/Kconfig"
source "drivers/misc/mediatek/sensors-1.0/sensorHub/Kconfig"
#source "drivers/misc/mediatek/sensors-1.0/geofence/Kconfig"
source "drivers/misc/mediatek/sensors-1.0/biometric/Kconfig"
source "drivers/misc/mediatek/sensors-1.0/sensorfusion/Kconfig"
source "drivers/misc/mediatek/sensors-1.0/oppo_virtual_sensor/Kconfig"
source "drivers/misc/mediatek/sensors-1.0/oppo_virtual_sensor/camera_protecthub/Kconfig"
source "drivers/misc/mediatek/sensors-1.0/oppo_virtual_sensor/free_fallhub/Kconfig"
source "drivers/misc/mediatek/sensors-1.0/oppo_virtual_sensor/pickup_detecthub/Kconfig"
source "drivers/misc/mediatek/sensors-1.0/oppo_virtual_sensor/fp_displayhub/Kconfig"
source "drivers/misc/mediatek/sensors-1.0/oppo_virtual_sensor/lux_aodhub/Kconfig"
source "drivers/misc/mediatek/sensors-1.0/oppo_virtual_sensor/pedo_minutehub/Kconfig"
source "drivers/misc/mediatek/sensors-1.0/oppo_virtual_sensor/oppo_activity_recognitionhub/Kconfig"
source "drivers/misc/mediatek/sensors-1.0/oppo_virtual_sensor/tp_gesturehub/Kconfig"
source "drivers/misc/mediatek/sensors-1.0/oppo_virtual_sensor/elevator_detecthub/Kconfig"
```

## drivers/misc/mediatek/sensors-1.0/oppo_virtual_sensor/Kconfig
```kconfig
config OPLUS_FEATURE_SENSOR_ALGORITHM
	bool "oppo vritual sensor config"
	default n
```

## drivers/misc/mediatek/sensors-1.0/oppo_virtual_sensor/oppo_activity_recognitionhub/Kconfig
```kconfig
config OPLUS_FEATURE_ACTIVITY_RECOGNITION
    bool "oppo_activity_recognition for MediaTek package"
    default n
```

## drivers/soc/Kconfig
```kconfig
menu "SOC (System On Chip) specific Drivers"

source "drivers/soc/actions/Kconfig"
source "drivers/soc/amlogic/Kconfig"
source "drivers/soc/atmel/Kconfig"
source "drivers/soc/bcm/Kconfig"
source "drivers/soc/fsl/Kconfig"
source "drivers/soc/imx/Kconfig"
source "drivers/soc/mediatek/Kconfig"
source "drivers/soc/qcom/Kconfig"
source "drivers/soc/renesas/Kconfig"
source "drivers/soc/rockchip/Kconfig"
source "drivers/soc/samsung/Kconfig"
source "drivers/soc/sunxi/Kconfig"
source "drivers/soc/tegra/Kconfig"
source "drivers/soc/ti/Kconfig"
source "drivers/soc/ux500/Kconfig"
source "drivers/soc/versatile/Kconfig"
source "drivers/soc/zte/Kconfig"
#ifdef VENDOR_EDIT
# Bin.Li@EXP.BSP.bootloader.bootflow, 2017/05/15, Add for oppo device info and oppo project
source "drivers/soc/oppo/Kconfig"
#endif /*VENDOR_EDIT*/
#ifdef OPLUS_FEATURE_IOMONITOR
source "drivers/soc/oplus/iomonitor/Kconfig"
#endif /*OPLUS_FEATURE_IOMONITOR*/
#ifdef VENDOR_EDIT
#wen.luo@BSP.Kernel.Stability 2020/03/25 add for oplus kernel system
source "drivers/soc/oplus/system/Kconfig"
#endif /* VENDOR_EDIT */

#ifdef VENDOR_EDIT
# Bin.Li@EXP.BSP.bootloader.bootflow, 2017/05/15, Add for oppo device info and oppo project
source "drivers/soc/oppo/Kconfig"
#endif /*VENDOR_EDIT*/

#ifdef OPLUS_FEATURE_HEALTHINFO
#Jiheng.Xie@BSP.Kernel.Performance 2020/06/18 add for oppo healthinfo
source "drivers/soc/oplus/oppo_healthinfo/Kconfig"
#endif /*OPLUS_FEATURE_HEALTHINFO*/

#ifdef OPLUS_FEATURE_MIDAS
source "drivers/soc/oplus/oplus_midas/Kconfig"
#endif /*OPLUS_FEATURE_MIDAS*/

#ifdef OPLUS_FEATURE_LOWMEM_DBG
source "drivers/soc/oplus/lowmem_dbg/Kconfig"
##endif /* OPLUS_FEATURE_LOWMEM_DBG */
endmenu
```

## drivers/soc/oplus/system/cmdline_parser/Kconfig
```kconfig
config OPLUS_FEATURE_CMDLINE
  tristate "Oplus command line"
  default n
  help 
        define this config to get command line.
```

## drivers/soc/oppo/Kconfig
```kconfig
#ifdef VENDOR_EDIT
# Bin.Li@EXP.BSP.bootloader.bootflow, 2017/05/15, Add for config oppo  software common soft
config OPPO_ARCH_FILE
    bool "for build directory oppo"
    ---help---
    say Y to buid in

config OPPO_COMMON_SOFT
        bool "config oppo common software"
        select OPPO_ARCH_FILE
        help
        define this config to get project verion from sharemem.
        Maybe this value is from CDT or dynamic identify by hardware
        id.

config OPPO_DEVICE_IFNO
        bool "config oppo devinfo"
        select OPPO_ARCH_FILE
        help
        define this config to compile devinfo.c for device register.

source "drivers/soc/oppo/oppo_project/Kconfig"
source "drivers/soc/oppo/oppo_devinfo/Kconfig"

source "drivers/soc/oppo/oppo_hypnus/Kconfig"
#ifdef VENDOR_EDIT
#//wenbin.liu@PSW.Kernel.MM, 2018/05/23, Add for Healthinfo monitor
source "drivers/soc/oppo/oppo_healthinfo/Kconfig"
#endif /* VENDOR_EDIT */
```

## mm/malloc_track/Kconfig.in
```kconfig
# SPDX-License-Identifier: GPL-2.0-only
# Copyright (C) 2018-2020 Oplus. All rights reserved.

config MEMLEAK_DETECT_THREAD
	bool "One kernel thread to detect memleak and dump infomation to log"
	default y if OPPO_MEMLEAK_DETECT="true"
	default n
	help
	  a daemon to monitor kernel memory leak.

config VMALLOC_DEBUG
	bool "trace vmalloc called information with a stack"
	default n
	help
	  trace vmalloc called information with a stack.
```
